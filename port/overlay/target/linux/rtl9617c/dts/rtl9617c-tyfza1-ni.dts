// SPDX-License-Identifier: GPL-2.0-only
#include "rtl9617c-tyfza1-dma-tx.dts"
#include <dt-bindings/gpio/gpio.h>
#include "rtl9617c-tyfza1-leds.dtsi"

/ { model = "Tianyi TYFZA1 (native NI/DMA bring-up)"; };

&{/soc/ethernet@4f4300000} {
	reg = <4 0xf4300000 0 0x10000>, <0 0xf4500000 0 0x2000>,
	      <4 0xf7001000 0 0x1000>, <4 0xf432d000 0 0x1000>,
	      <4 0xf4320098 0 4>, <4 0xf432f000 0 0x1000>;
	reg-names = "ni", "xram", "dma-lso", "qm-axi-reorder", "block-reset",
		    "l3fe-axi-reorder";
	realtek,qm-rx;
	realtek,lan-phys = <&phy0 &phy1 &phy2 &phy3>;
	interrupts = <GIC_SPI 84 IRQ_TYPE_LEVEL_HIGH>;
};

&{/soc} {
	gpio0: gpio@4f43292c0 {
		compatible = "realtek,rtl9617c-gpio";
		reg = <4 0xf43292c0 0 0xb4>;
		gpio-controller;
		#gpio-cells = <2>;
		gpio-ranges = <&pinctrl 0 0 160>;
	};
};
