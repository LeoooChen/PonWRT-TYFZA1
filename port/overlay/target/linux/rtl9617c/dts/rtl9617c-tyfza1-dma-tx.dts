// SPDX-License-Identifier: GPL-2.0-only
#include "rtl9617c-tyfza1-xram-lan.dts"

/ { model = "Tianyi TYFZA1 (native DMA TX bring-up)"; };

&{/soc/ethernet@4f4300000} {
	reg = <4 0xf4300000 0 0x10000>, <0 0xf4500000 0 0x2000>,
	      <4 0xf7001000 0 0x1000>, <4 0xf432e000 0 0x1000>;
	reg-names = "ni", "xram", "dma-lso", "dma-axi-reorder";
	realtek,dma-tx;
};
