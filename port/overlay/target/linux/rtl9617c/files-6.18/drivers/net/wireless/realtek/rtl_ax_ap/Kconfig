## port/overlay/target/linux/rtl9617c/files-6.18/drivers/net/wireless/realtek/rtl_ax_ap/Kconfig
```kconfig
# SPDX-License-Identifier: GPL-2.0-only
config RTL_AX_AP
	tristate "TYFZA1 RTL8852C/RTL8192XB native AP backend"
	depends on PCI && ARCH_RTL9617C && MAC80211 && RTL9617C_XRAM_ETH
	select FW_LOADER
	help
	  Native PCI endpoint identity, AP power, calibration and channel12 WCPU
	  firmware download for both TYFZA1 radios. Native mac80211 monitor RX
	  is provided for RTL8852C 5GHz and RTL8192XB 2.4GHz at 20MHz.
	  AP transmission, association and the remaining RF controls are in progress.
```
